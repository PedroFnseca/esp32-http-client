/**
 * @file bench_httpclient_arduinojson.ino
 * @brief Benchmark: HTTPClient + ArduinoJson
 *
 * Performs 100 GET requests to https://jsonplaceholder.typicode.com/users,
 * parses the full user array with ArduinoJson and collects metrics:
 *  - Execution time per request (ms)
 *  - Free heap before and after each request (bytes)
 *  - Minimum heap recorded by the system (bytes)
 *
 * At the end, prints a report with averages, peaks and minimums identical to
 * the report generated by the esp32-http-client benchmark.
 *
 * Dependencies: ArduinoJson (>= 6.x), WiFi, HTTPClient (ESP32 Arduino core)
 */

#include <Arduino.h>
#include <WiFi.h>
#include <WiFiClientSecure.h>
#include <HTTPClient.h>
#include <ArduinoJson.h>

const char* WIFI_SSID     = "YOUR_SSID";
const char* WIFI_PASSWORD = "YOUR_PASSWORD";

const char* TARGET_URL    = "https://jsonplaceholder.typicode.com/users";
const int   NUM_REQUESTS  = 100;

struct User {
  int    id;
  char   name[64];
  char   username[32];
  char   email[64];
  char   street[64];
  char   suite[32];
  char   city[32];
  char   zipcode[16];
  char   lat[16];
  char   lng[16];
  char   phone[32];
  char   website[32];
  char   companyName[64];
  char   catchPhrase[64];
  char   bs[64];
};

struct Metrics {
  uint32_t timeMs[NUM_REQUESTS];
  int32_t  heapBeforeBytes[NUM_REQUESTS];
  int32_t  heapAfterBytes[NUM_REQUESTS];
  uint32_t heapMinSystem[NUM_REQUESTS];
  int      successCount;
  int      failCount;
};

static Metrics g_metrics;

static void printSeparator() {
  Serial.println(F("============================================================"));
}

static void waitForWifi() {
  WiFi.begin(WIFI_SSID, WIFI_PASSWORD);
  Serial.print(F("[WiFi] Connecting"));
  while (WiFi.status() != WL_CONNECTED) {
    delay(500);
    Serial.print('.');
  }
  Serial.println();
  Serial.printf("[WiFi] Connected  IP: %s\n", WiFi.localIP().toString().c_str());
}

static int runRequest(int index) {
  g_metrics.heapBeforeBytes[index] = (int32_t)esp_get_free_heap_size();

  unsigned long t0 = millis();

  WiFiClientSecure tls;
  tls.setInsecure();

  HTTPClient http;
  http.begin(tls, TARGET_URL);
  int code = http.GET();

  if (code != 200) {
    http.end();
    g_metrics.timeMs[index]         = (uint32_t)(millis() - t0);
    g_metrics.heapAfterBytes[index] = (int32_t)esp_get_free_heap_size();
    g_metrics.heapMinSystem[index]  = (uint32_t)esp_get_minimum_free_heap_size();
    return code;
  }

  DynamicJsonDocument doc(16384);
  String payload = http.getString();
  http.end();

  DeserializationError err = deserializeJson(doc, payload);

  if (err) {
    g_metrics.timeMs[index]         = (uint32_t)(millis() - t0);
    g_metrics.heapAfterBytes[index] = (int32_t)esp_get_free_heap_size();
    g_metrics.heapMinSystem[index]  = (uint32_t)esp_get_minimum_free_heap_size();
    return -99;
  }

  JsonArray arr = doc.as<JsonArray>();
  volatile int totalUsers = 0;

  for (JsonObject user : arr) {
    User u;
    u.id = user["id"].as<int>();
    strlcpy(u.name,       user["name"]       | "", sizeof(u.name));
    strlcpy(u.username,   user["username"]   | "", sizeof(u.username));
    strlcpy(u.email,      user["email"]      | "", sizeof(u.email));
    strlcpy(u.phone,      user["phone"]      | "", sizeof(u.phone));
    strlcpy(u.website,    user["website"]    | "", sizeof(u.website));

    JsonObject addr = user["address"];
    strlcpy(u.street,  addr["street"]  | "", sizeof(u.street));
    strlcpy(u.suite,   addr["suite"]   | "", sizeof(u.suite));
    strlcpy(u.city,    addr["city"]    | "", sizeof(u.city));
    strlcpy(u.zipcode, addr["zipcode"] | "", sizeof(u.zipcode));
    strlcpy(u.lat,     addr["geo"]["lat"] | "", sizeof(u.lat));
    strlcpy(u.lng,     addr["geo"]["lng"] | "", sizeof(u.lng));

    JsonObject company = user["company"];
    strlcpy(u.companyName, company["name"]         | "", sizeof(u.companyName));
    strlcpy(u.catchPhrase, company["catchPhrase"]  | "", sizeof(u.catchPhrase));
    strlcpy(u.bs,          company["bs"]           | "", sizeof(u.bs));

    totalUsers += u.id;
  }

  (void)totalUsers;

  g_metrics.timeMs[index]         = (uint32_t)(millis() - t0);
  g_metrics.heapAfterBytes[index] = (int32_t)esp_get_free_heap_size();
  g_metrics.heapMinSystem[index]  = (uint32_t)esp_get_minimum_free_heap_size();

  return 200;
}

static void printReport() {
  uint32_t timeMin = UINT32_MAX, timeMax = 0, timeSum = 0;
  for (int i = 0; i < NUM_REQUESTS; i++) {
    if (g_metrics.timeMs[i] < timeMin) timeMin = g_metrics.timeMs[i];
    if (g_metrics.timeMs[i] > timeMax) timeMax = g_metrics.timeMs[i];
    timeSum += g_metrics.timeMs[i];
  }
  float timeAvg = (float)timeSum / NUM_REQUESTS;

  int32_t heapUsedMin = INT32_MAX, heapUsedMax = INT32_MIN;
  int64_t heapUsedSum = 0;
  for (int i = 0; i < NUM_REQUESTS; i++) {
    int32_t used = g_metrics.heapBeforeBytes[i] - g_metrics.heapAfterBytes[i];
    if (used < heapUsedMin) heapUsedMin = used;
    if (used > heapUsedMax) heapUsedMax = used;
    heapUsedSum += used;
  }
  float heapUsedAvg = (float)heapUsedSum / NUM_REQUESTS;

  uint32_t sysHeapMinAll = UINT32_MAX;
  for (int i = 0; i < NUM_REQUESTS; i++) {
    if (g_metrics.heapMinSystem[i] < sysHeapMinAll)
      sysHeapMinAll = g_metrics.heapMinSystem[i];
  }

  int32_t heapStart = g_metrics.heapBeforeBytes[0];
  int32_t heapEnd   = g_metrics.heapAfterBytes[NUM_REQUESTS - 1];
  
  int64_t totalFootprint = 0;
  for (int i = 0; i < NUM_REQUESTS; i++) {
    totalFootprint += (heapStart - g_metrics.heapAfterBytes[i]);
  }
  float avgFootprint = (float)totalFootprint / NUM_REQUESTS;
  
  float fragPct = 0.0f;
  if (heapStart > 0) {
    fragPct = (avgFootprint / (float)heapStart) * 100.0f;
    if (fragPct < 0) fragPct = 0;
  }

  printSeparator();
  Serial.println(F("  BENCHMARK: HTTPClient + ArduinoJson"));
  printSeparator();
  Serial.printf("  Total requests     : %d\n", NUM_REQUESTS);
  Serial.printf("  Success            : %d\n", g_metrics.successCount);
  Serial.printf("  Failed             : %d\n", g_metrics.failCount);
  printSeparator();
  Serial.println(F("  [TIME PER REQUEST]"));
  Serial.printf("    Min     : %u ms\n", timeMin);
  Serial.printf("    Avg     : %.1f ms\n", timeAvg);
  Serial.printf("    Max     : %u ms\n", timeMax);
  printSeparator();
  Serial.println(F("  [HEAP USED PER REQUEST  (before - after)]"));
  Serial.printf("    Min     : %ld bytes  (%.1f KB)\n", (long)heapUsedMin, heapUsedMin / 1024.0f);
  Serial.printf("    Avg     : %.0f bytes  (%.1f KB)\n", heapUsedAvg,      heapUsedAvg / 1024.0f);
  Serial.printf("    Max     : %ld bytes  (%.1f KB)\n", (long)heapUsedMax, heapUsedMax / 1024.0f);
  printSeparator();
  Serial.println(F("  [SYSTEM MINIMUM HEAP  (esp_get_minimum_free_heap_size)]"));
  Serial.printf("    Absolute min    : %u bytes  (%.1f KB)\n", sysHeapMinAll, sysHeapMinAll / 1024.0f);
  printSeparator();
  Serial.println(F("  [HEAP FRAGMENTATION  (estimate after all requests)]"));
  Serial.printf("    Initial heap    : %ld bytes  (%.1f KB)\n", (long)heapStart, heapStart / 1024.0f);
  Serial.printf("    Final heap      : %ld bytes  (%.1f KB)\n", (long)heapEnd,   heapEnd   / 1024.0f);
  Serial.printf("    Estimate        : %.1f%%\n", fragPct);
  printSeparator();
}

void setup() {
  Serial.begin(115200);
  delay(500);

  printSeparator();
  Serial.println(F("  STARTING BENCHMARK  >>  HTTPClient + ArduinoJson"));
  printSeparator();

  waitForWifi();

  g_metrics.successCount = 0;
  g_metrics.failCount    = 0;

  for (int i = 0; i < NUM_REQUESTS; i++) {
    Serial.printf("[REQ %3d/%d] ", i + 1, NUM_REQUESTS);

    int code = runRequest(i);
    if (code == 200) {
      g_metrics.successCount++;
      Serial.printf("OK   %u ms   heap: %ld -> %ld bytes\n",
                    g_metrics.timeMs[i],
                    (long)g_metrics.heapBeforeBytes[i],
                    (long)g_metrics.heapAfterBytes[i]);
    } else {
      g_metrics.failCount++;
      if (code == -99) {
        Serial.printf("FAIL  %u ms  [JSON parse error]\n", g_metrics.timeMs[i]);
      } else {
        Serial.printf("FAIL  %u ms  [HTTP %d: %s]\n",
                      g_metrics.timeMs[i], code,
                      HTTPClient::errorToString(code).c_str());
      }
    }

    delay(50);
  }

  g_metrics.heapAfterBytes[NUM_REQUESTS - 1] = (int32_t)esp_get_free_heap_size();

  printReport();
}

void loop() {
  delay(60000);
}
