/**
 * @file bench_esp32_http_client.ino
 * @brief Benchmark: esp32-http-client
 *
 * Performs 100 GET requests to https://jsonplaceholder.typicode.com/users,
 * extracts the same fields as the HTTPClient + ArduinoJson benchmark and
 * collects the same metrics:
 *  - Execution time per request (ms)
 *  - Free heap before and after each request (bytes)
 *  - Minimum heap recorded by the system (bytes)
 *
 * At the end, prints a report with averages, peaks and minimums identical to
 * the report generated by the HTTPClient + ArduinoJson benchmark.
 *
 * Dependencies: esp32-http-client (this library), WiFi (ESP32 Arduino core)
 */
#include <Arduino.h>
#include <WiFi.h>
#include "ESP32HTTPClient.h"

const char* WIFI_SSID     = "YOUR_SSID";
const char* WIFI_PASSWORD = "YOUR_PASSWORD";

const int   NUM_REQUESTS  = 100;

ESP32HTTPClient client("https://jsonplaceholder.typicode.com");

static char g_id[8];
static char g_name[64];
static char g_username[32];
static char g_email[64];
static char g_street[64];
static char g_suite[32];
static char g_city[32];
static char g_zipcode[16];
static char g_lat[16];
static char g_lng[16];
static char g_phone[32];
static char g_website[32];
static char g_companyName[64];
static char g_catchPhrase[64];
static char g_bs[64];

struct Metrics {
  uint32_t timeMs[NUM_REQUESTS];
  int32_t  heapBeforeBytes[NUM_REQUESTS];
  int32_t  heapAfterBytes[NUM_REQUESTS];
  uint32_t heapMinSystem[NUM_REQUESTS];
  int      successCount;
  int      failCount;
};

static Metrics g_metrics;

static void printSeparator() {
  Serial.println(F("============================================================"));
}

static void waitForWifi() {
  WiFi.begin(WIFI_SSID, WIFI_PASSWORD);
  Serial.print(F("[WiFi] Connecting"));
  while (WiFi.status() != WL_CONNECTED) {
    delay(500);
    Serial.print('.');
  }
  Serial.println();
  Serial.printf("[WiFi] Connected  IP: %s\n", WiFi.localIP().toString().c_str());
}

static bool runRequest(int index) {
  g_metrics.heapBeforeBytes[index] = (int32_t)esp_get_free_heap_size();

  unsigned long t0 = millis();

  client.get("/users")
    .getBody("0.id",                  g_id,          sizeof(g_id))
    .getBody("0.name",                g_name,        sizeof(g_name))
    .getBody("0.username",            g_username,    sizeof(g_username))
    .getBody("0.email",               g_email,       sizeof(g_email))
    .getBody("0.phone",               g_phone,       sizeof(g_phone))
    .getBody("0.website",             g_website,     sizeof(g_website))
    .getBody("0.address.street",      g_street,      sizeof(g_street))
    .getBody("0.address.suite",       g_suite,       sizeof(g_suite))
    .getBody("0.address.city",        g_city,        sizeof(g_city))
    .getBody("0.address.zipcode",     g_zipcode,     sizeof(g_zipcode))
    .getBody("0.address.geo.lat",     g_lat,         sizeof(g_lat))
    .getBody("0.address.geo.lng",     g_lng,         sizeof(g_lng))
    .getBody("0.company.name",        g_companyName, sizeof(g_companyName))
    .getBody("0.company.catchPhrase", g_catchPhrase, sizeof(g_catchPhrase))
    .getBody("0.company.bs",          g_bs,          sizeof(g_bs));

  g_metrics.timeMs[index]         = (uint32_t)(millis() - t0);
  g_metrics.heapAfterBytes[index] = (int32_t)esp_get_free_heap_size();
  g_metrics.heapMinSystem[index]  = (uint32_t)esp_get_minimum_free_heap_size();

  return (client.getStatusCode() == 200);
}

static void printReport() {
  uint32_t timeMin = UINT32_MAX, timeMax = 0, timeSum = 0;
  for (int i = 0; i < NUM_REQUESTS; i++) {
    if (g_metrics.timeMs[i] < timeMin) timeMin = g_metrics.timeMs[i];
    if (g_metrics.timeMs[i] > timeMax) timeMax = g_metrics.timeMs[i];
    timeSum += g_metrics.timeMs[i];
  }
  float timeAvg = (float)timeSum / NUM_REQUESTS;

  int32_t heapUsedMin = INT32_MAX, heapUsedMax = INT32_MIN;
  int64_t heapUsedSum = 0;
  for (int i = 0; i < NUM_REQUESTS; i++) {
    int32_t used = g_metrics.heapBeforeBytes[i] - g_metrics.heapAfterBytes[i];
    if (used < heapUsedMin) heapUsedMin = used;
    if (used > heapUsedMax) heapUsedMax = used;
    heapUsedSum += used;
  }
  float heapUsedAvg = (float)heapUsedSum / NUM_REQUESTS;

  uint32_t sysHeapMinAll = UINT32_MAX;
  for (int i = 0; i < NUM_REQUESTS; i++) {
    if (g_metrics.heapMinSystem[i] < sysHeapMinAll)
      sysHeapMinAll = g_metrics.heapMinSystem[i];
  }

  int32_t heapStart = g_metrics.heapBeforeBytes[0];
  int32_t heapEnd   = g_metrics.heapAfterBytes[NUM_REQUESTS - 1];
  
  int64_t totalFootprint = 0;
  for (int i = 0; i < NUM_REQUESTS; i++) {
    totalFootprint += (heapStart - g_metrics.heapAfterBytes[i]);
  }
  float avgFootprint = (float)totalFootprint / NUM_REQUESTS;
  
  float fragPct = 0.0f;
  if (heapStart > 0) {
    fragPct = (avgFootprint / (float)heapStart) * 100.0f;
    if (fragPct < 0) fragPct = 0;
  }

  printSeparator();
  Serial.println(F("  BENCHMARK: esp32-http-client"));
  printSeparator();
  Serial.printf("  Total requests     : %d\n", NUM_REQUESTS);
  Serial.printf("  Success            : %d\n", g_metrics.successCount);
  Serial.printf("  Failed             : %d\n", g_metrics.failCount);
  printSeparator();
  Serial.println(F("  [TIME PER REQUEST]"));
  Serial.printf("    Min     : %u ms\n", timeMin);
  Serial.printf("    Avg     : %.1f ms\n", timeAvg);
  Serial.printf("    Max     : %u ms\n", timeMax);
  printSeparator();
  Serial.println(F("  [HEAP USED PER REQUEST  (before - after)]"));
  Serial.printf("    Min     : %ld bytes  (%.1f KB)\n", (long)heapUsedMin, heapUsedMin / 1024.0f);
  Serial.printf("    Avg     : %.0f bytes  (%.1f KB)\n", heapUsedAvg,      heapUsedAvg / 1024.0f);
  Serial.printf("    Max     : %ld bytes  (%.1f KB)\n", (long)heapUsedMax, heapUsedMax / 1024.0f);
  printSeparator();
  Serial.println(F("  [SYSTEM MINIMUM HEAP  (esp_get_minimum_free_heap_size)]"));
  Serial.printf("    Absolute min    : %u bytes  (%.1f KB)\n", sysHeapMinAll, sysHeapMinAll / 1024.0f);
  printSeparator();
  Serial.println(F("  [HEAP FRAGMENTATION  (estimate after all requests)]"));
  Serial.printf("    Initial heap    : %ld bytes  (%.1f KB)\n", (long)heapStart, heapStart / 1024.0f);
  Serial.printf("    Final heap      : %ld bytes  (%.1f KB)\n", (long)heapEnd,   heapEnd   / 1024.0f);
  Serial.printf("    Estimate        : %.1f%%\n", fragPct);
  printSeparator();
}

void setup() {
  Serial.begin(115200);
  delay(500);

  printSeparator();
  Serial.println(F("  STARTING BENCHMARK  >>  esp32-http-client"));
  printSeparator();

  waitForWifi();

  g_metrics.successCount = 0;
  g_metrics.failCount    = 0;

  for (int i = 0; i < NUM_REQUESTS; i++) {
    Serial.printf("[REQ %3d/%d] ", i + 1, NUM_REQUESTS);

    bool ok = runRequest(i);
    if (ok) {
      g_metrics.successCount++;
      Serial.printf("OK   %u ms   heap: %ld -> %ld bytes\n",
                    g_metrics.timeMs[i],
                    (long)g_metrics.heapBeforeBytes[i],
                    (long)g_metrics.heapAfterBytes[i]);
    } else {
      g_metrics.failCount++;
      Serial.printf("FAIL  %u ms\n", g_metrics.timeMs[i]);
    }

    delay(50);
  }

  client.end();
  g_metrics.heapAfterBytes[NUM_REQUESTS - 1] = (int32_t)esp_get_free_heap_size();

  printReport();
}

void loop() {
  delay(60000);
}
